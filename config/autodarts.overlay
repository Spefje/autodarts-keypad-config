/ {
    chosen {
        zmk,kscan = &kscan0;
    };

    kscan0: kscan {
        compatible = "zmk,kscan-gpio-matrix";
        diode-direction = "col2row";

        row-gpios
            = <&gpio0 13 (GPIO_ACTIVE_HIGH | GPIO_PULL_DOWN)> // Stift 2 -> P0.13
            , <&gpio0 15 (GPIO_ACTIVE_HIGH | GPIO_PULL_DOWN)> // Stift 7 -> P0.15
            , <&gpio0 17 (GPIO_ACTIVE_HIGH | GPIO_PULL_DOWN)> // Stift 6 -> P0.17
            , <&gpio0 20 (GPIO_ACTIVE_HIGH | GPIO_PULL_DOWN)> // Stift 4 -> P0.20
            ;

        col-gpios
            = <&gpio0 22 GPIO_ACTIVE_HIGH> // Stift 3 -> P0.22
            , <&gpio0 24 GPIO_ACTIVE_HIGH> // Stift 1 -> P0.24
            , <&gpio1 0  GPIO_ACTIVE_HIGH> // Stift 5 -> P1.00
            ;
    };
};
